## conf/layer.conf
```bitbake
BBPATH .= ":${LAYERDIR}"

BBFILE_COLLECTIONS             += "qti-camera"
BBFILE_PRIORITY_qti-camera =  "12"
BBFILE_PATTERN_qti-camera := "^${LAYERDIR}/"

LAYERSERIES_COMPAT_qti-camera = "kirkstone scarthgap"

BBFILES += "${LAYERDIR}/recipes/*/*.bb \
            ${LAYERDIR}/recipes/*/*.bbappend"

LAYERDEPENDS_qti-camera = " "
LAYERSERIES_COMPAT_qti-camera = "kirkstone scarthgap"
```
